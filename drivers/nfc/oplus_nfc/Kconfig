## drivers/nfc/oplus_nfc/Kconfig
```kconfig
# SPDX-License-Identifier: GPL-2.0-only
# Copyright (C) 2018-2020 Oplus. All rights reserved.

config OPLUS_NFC
  bool "config oplus nfc chipset"
  default n
  help
	define this config to get chipset version from dts.

config NFC_PN553_DEVICES
	bool "Nxp pn553 NCI protocol driver (I2C) devices"
	default n
	---help---
	  You'll have to say Y if your computer contains an I2C device that
	  you want to use under Linux.

	  You can say N here if you don't have any SPI connected to your computer.

config NXP_P73_DEVICES
	bool "Nxp P73 secure element protocol driver (SPI) devices"
	default n
	---help---
	  You'll have to say Y if your computer contains an SPI device that
	  you want to use under Linux.

	  You can say N here if you don't have any SPI connected to your computer.
```

## drivers/soc/oplus/oplus_sensor/Kconfig
```kconfig
# SPDX-License-Identifier: GPL-2.0-only
# Copyright (C) 2018-2020 Oplus. All rights reserved.

config OPLUS_SENSOR
	tristate "config oplus sensor for kernel"
	default n
	help
	  define this config to define oplus sensor
```
